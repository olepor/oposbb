## conf/bblayers.conf
```bitbake
BBPATH := "${TOPDIR}"
BBFILES ?= ""
BBLAYERS = "${HOME}/misc/OS/oposbb/meta-opos "
```

## meta-opos/conf/layer.conf
```bitbake
# We have a conf and classes directory, add to BBPATH
BBPATH .= ":${LAYERDIR}"

# We have recipes-* directories, add to BBFILES
BBFILES += "${LAYERDIR}/recipes-*/*/*.bb ${LAYERDIR}/recipes-*/*/*.bbappend"

BBFILE_COLLECTIONS += "OPOS"
BBFILE_PATTERN_OPOS = "^${LAYERDIR}/"
BBFILE_PRIORITY_OPOS = "1"

# This should only be incremented on significant changes that will
# cause compatibility issues with other layers
LAYERVERSION_OPOS = "1"

LAYERDEPENDS_OPOS = "core"
```
